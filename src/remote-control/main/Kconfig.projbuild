## src/remote-control/main/Kconfig.projbuild
```kconfig
menu "Example Configuration"

    orsource "$IDF_PATH/examples/common_components/env_caps/$IDF_TARGET/Kconfig.env_caps"

    config GPIO_OUTPUT_0
        int "GPIO output pin 0"
        range ENV_GPIO_RANGE_MIN ENV_GPIO_OUT_RANGE_MAX
        default 8 if IDF_TARGET_ESP32C2 || IDF_TARGET_ESP32H2 || IDF_TARGET_ESP32C5 || IDF_TARGET_ESP32C61
        default 8 if IDF_TARGET_ESP32H21
        default 18
        help
            GPIO pin number to be used as GPIO_OUTPUT_IO_0.

    config GPIO_OUTPUT_1
        int "GPIO output pin 1"
        range ENV_GPIO_RANGE_MIN ENV_GPIO_OUT_RANGE_MAX
        default 9 if IDF_TARGET_ESP32C2 || IDF_TARGET_ESP32H2 || IDF_TARGET_ESP32C5 || IDF_TARGET_ESP32C61
        default 9 if IDF_TARGET_ESP32H21
        default 19
        help
            GPIO pin number to be used as GPIO_OUTPUT_IO_1.

    config GPIO_INPUT_0
        int "GPIO input pin 0"
        range ENV_GPIO_RANGE_MIN ENV_GPIO_IN_RANGE_MAX
        default 4
        help
            GPIO pin number to be used as GPIO_INPUT_IO_0.

    config GPIO_INPUT_1
        int "GPIO input pin 1"
        range ENV_GPIO_RANGE_MIN ENV_GPIO_IN_RANGE_MAX
        default 5
        help
            GPIO pin number to be used as GPIO_INPUT_IO_1.

endmenu

menu "WiFi Configuration"

    config WIFI_SSID
        string "WiFi SSID"
        default ""
        help
            SSID of the WiFi network to connect to. Set this in menuconfig.

    config WIFI_PASSWORD
        string "WiFi Password"
        default ""
        help
            Password of the WiFi network to connect to. Set this in menuconfig.

endmenu

menu "Music Assistant Configuration"

    config MUSIC_ASSISTANT_HOST
        string "Music Assistant Host"
        default ""
        help
            Host address of the Music Assistant server.

    config MUSIC_ASSISTANT_API_KEY
        string "Music Assistant API Key"
        default ""
        help
            API key for the Music Assistant server.

endmenu
```
